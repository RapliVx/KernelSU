## kernel/Kconfig
```kconfig
menu "KernelSU"

config KSU
	tristate "KernelSU function support"
	depends on KPROBES
	default y
	help
	  Enable kernel-level root privileges on Android System.
	  Requires CONFIG_KPROBES for kernel hooking support.
	  To compile as a module, choose M here: the
	  module will be called kernelsu.

config KSU_KPROBES_HOOK
	bool "Use kprobes for kernelsu"
	depends on KSU
	depends on KPROBES
	default y
	help
	  Disable if you use manual hooks.

config KSU_DEBUG
	bool "KernelSU debug mode"
	depends on KSU
	default n
	help
	  Enable KernelSU debug mode.

config KSU_ALLOWLIST_WORKAROUND
        bool "KernelSU Session Keyring Init workaround"
        depends on KSU
        default n
        help
          Enable session keyring init workaround for problematic devices.
          Useful for situations where the SU allowlist is not kept after a reboot.

endmenu
```
